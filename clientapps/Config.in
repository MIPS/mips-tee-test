## clientapps/Config.in
```kconfig
source "$BR2_EXTERNAL_MIPS_REE_PATH/package/mips-tee-test/clientapps/test_starter_ca/Config.in"
```

## clientapps/test_starter_ca/Config.in
```kconfig
config BR2_PACKAGE_TEST_STARTER_CA
	bool "test_starter_ca"
	depends on BR2_PACKAGE_LIBTEEC
	help
	  Test starter client application.
```

## xtest/Config.in
```kconfig
config BR2_PACKAGE_XTEST
	bool "xtest"
	depends on BR2_PACKAGE_LIBTEEC
	help
	  Test suite for testing the GlobalPlatform Client API.

if BR2_PACKAGE_XTEST

config BR2_PACKAGE_XTEST_GP
	bool "xtest_gp"
	help
	  Extends the xtest suite with GlobalPlatform tests.

endif
```
